## src-comcerto-openwrt-ls1024_7.0.0-rc0-gpl/target/linux/Config.in
```kconfig
#
choice
	prompt "Linux Kernel Version" if DEVEL
	default LINUX_3_19

config LINUX_3_2
	bool "Linux Kernel 3.2"
	help
	  Select Linux Kernel 3.2 

config LINUX_3_19
	bool "Linux Kernel 3.19"
	help
	  Select Linux Kernel 3.19

config LINUX_4_1
	bool "Linux Kernel 4.1"
	help
	  Select Linux Kernel 4.1
endchoice
```
